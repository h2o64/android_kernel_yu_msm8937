/* Copyright (c) 2013, The Linux Foundation. All rights reserved.
 *
 * This program is free software; you can redistribute it and/or modify
 * it under the terms of the GNU General Public License version 2 and
 * only version 2 as published by the Free Software Foundation.
 *
 * This program is distributed in the hope that it will be useful,
 * but WITHOUT ANY WARRANTY; without even the implied warranty of
 * MERCHANTABILITY or FITNESS FOR A PARTICULAR PURPOSE.  See the
 * GNU General Public License for more details.
 */

/*---------------------------------------------------------------------------
 * This file is autogenerated file using gcdb parser. Please do not edit it.
 * Update input XML file to add a new entry or update variable in this file
 * VERSION = "1.1"
 *---------------------------------------------------------------------------*/
&mdss_mdp {
	dsi_hx8394_1080p_video_a_si_boe_p7701: \
	qcom,mdss_dsi_hx8394_1080p_video_a_si_boe_p7701 {
		qcom,mdss-dsi-panel-name = "ili9885_hx8394_video_a_si_boe_p7701";
		qcom,mdss-dsi-panel-controller = <&mdss_dsi0>;
		qcom,mdss-dsi-panel-type = "dsi_video_mode";
		qcom,mdss-dsi-panel-destination = "display_1";
		qcom,mdss-dsi-panel-framerate = <60>;
		qcom,mdss-dsi-virtual-channel-id = <0>;
		qcom,mdss-dsi-stream = <0>;
		qcom,mdss-dsi-panel-width = <1080>;
		qcom,mdss-dsi-panel-height = <1920>;
		qcom,mdss-dsi-h-front-porch = <45>;
		qcom,mdss-dsi-h-back-porch = <45>;
		qcom,mdss-dsi-h-pulse-width = <8>;
		qcom,mdss-dsi-h-sync-skew = <0>;
		qcom,mdss-dsi-v-back-porch = <18>;
		qcom,mdss-dsi-v-front-porch = <4>;
		qcom,mdss-dsi-v-pulse-width = <4>;
		qcom,mdss-dsi-h-left-border = <0>;
		qcom,mdss-dsi-h-right-border = <0>;
		qcom,mdss-dsi-v-top-border = <0>;
		qcom,mdss-dsi-v-bottom-border = <0>;
		qcom,mdss-dsi-bpp = <24>;
		qcom,mdss-dsi-color-order = "rgb_swap_rgb";
		qcom,mdss-dsi-underflow-color = <0xff>;
		qcom,mdss-dsi-border-color = <0>;
		qcom,mdss-dsi-on-command = [
		29 01 00 00 00 00 04 B9 FF 83 98
		29 01 00 00 00 00 0c B1 28 11 91 01 02 33 33 33 CD 43 0D  
		15 01 00 00 00 00 02 D2 44                       
		29 01 00 00 00 00 0a B2 40 80 AE 0C 12 45 01 11 00
		29 01 00 00 00 00 1a B4 00 FF 14 84 14 84 00 00 07 07 A6 00 07 3A 14 84 14 84 00 00 07 07 A6 3A 00
		//15 01 00 00 00 00 02 BD 01
		//15 01 00 00 00 00 02 B1 24                       
		15 01 00 00 00 00 02 BD 02
		29 01 00 00 00 00 04 D3 00 04 10
		15 01 00 00 00 00 02 BD 00
		29 01 00 00 00 00 30 D3 20 00 00 00 00 00 00 00 08 00 32 10 09 00 09 00 00 00 00 00 00 00 00 00 00 33 00 0B 0B 37 00 00 00 10 40 00 07 13 00 00 00 62 99 07 13 62 99
		29 01 00 00 00 00 29 D5 18 18 19 19 22 23 20 21 19 19 02 03 02 03 00 01 00 01 06 07 06 07 04 05 04 05 18 18 18 18 18 18 18 18 18 18 18 18 18 18
		29 01 00 00 00 00 29 D6 18 18 19 19 21 20 23 22 18 18 05 04 05 04 07 06 07 06 01 00 01 00 03 02 03 02 19 19 18 18 18 18 18 18 18 18 18 18 18 18
		15 01 00 00 00 00 02 CC 0E
		29 01 00 00 00 00 3b E0 0E 10 17 1C 1E 22 26 21 44 50 5C 5A 5B 68 6A 6C 7C 80 80 92 A7 50 4E 53 59 5C 63 71 7A 04 08 13 16 19 1D 1F 21 41 53 64 64 6E 7A 7C 7C 8A 92 92 A4 B9 5E 5E 61 65 65 6D 7B 7F
			
		15 01 00 00 78 00 02 11 00 	
		15 01 00 00 32 00 02 29 00
			];
		qcom,mdss-dsi-off-command = [05 01 00 00 32 00 02 28 00 \
			05 01 00 00 78 00 02 10 00];
		qcom,mdss-dsi-on-command-state = "dsi_lp_mode";
		qcom,mdss-dsi-off-command-state = "dsi_hs_mode";
            //Begin xiongdajun add ESD check for ili9885
             qcom,esd-check-enabled;
             qcom,mdss-dsi-panel-status-check-mode = "reg_read";         
		qcom,mdss-dsi-panel-status-command-state = "dsi_lp_mode";		
		qcom,mdss-dsi-panel-status-command = [14 01 00 01 05 00 01 0A];
             qcom,mdss-dsi-panel-status-read-length = <1>;
             qcom,mdss-dsi-panel-status-value = <0x9c>;
		//qcom,mdss-dsi-panel-status-value = <0x80 0x73 0x04>;
              //END xiongdajun add ESD check for ili9885
		qcom,mdss-dsi-h-sync-pulse = <1>;
		qcom,mdss-dsi-traffic-mode = "burst_mode";
		qcom,mdss-dsi-lane-map = "lane_map_0123";
		qcom,mdss-dsi-bllp-eof-power-mode;
		qcom,mdss-dsi-bllp-power-mode;
		qcom,mdss-dsi-lane-0-state;
		qcom,mdss-dsi-lane-1-state;
		qcom,mdss-dsi-lane-2-state;
		qcom,mdss-dsi-lane-3-state;
		qcom,mdss-dsi-panel-timings = [6F 36 24 00 \
			66 6A 2A 3A 2D 03 04 00];
		qcom,mdss-dsi-t-clk-post = <0x1e>;
		qcom,mdss-dsi-t-clk-pre = <0x38>;
		qcom,mdss-dsi-bl-min-level = <1>;
		qcom,mdss-dsi-bl-max-level = <4095>;
		qcom,mdss-dsi-dma-trigger = "trigger_sw";
		qcom,mdss-dsi-mdp-trigger = "none";
		qcom,mdss-dsi-bl-pmic-control-type = "bl_ctrl_wled";
		qcom,mdss-dsi-reset-sequence = <1 20>, <0 20>, <1 120>;
	};
};
