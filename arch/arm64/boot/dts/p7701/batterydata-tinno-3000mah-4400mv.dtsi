
qcom,tinno-3000mah {
	/* #2388598_HYHY_P770AN_ATL_3000mAh_averaged_MasterSlave_Apr11th2016*/
	qcom,max-voltage-uv = <4400000>;
	qcom,nom-batt-capacity-mah = <3000>;
	qcom,batt-id-kohm = <100>;
	qcom,battery-beta = <3435>;
	qcom,battery-type = "tinno-3000mah";
	qcom,chg-rslow-comp-c1 = <2784841>;
	qcom,chg-rslow-comp-c2 = <4070612>;
	qcom,chg-rs-to-rslow = <881205>;
	qcom,chg-rslow-comp-thr = <0xA8>;
	qcom,checksum = <0xE913>;
	qcom,gui-version = "PMI8950GUI - 2.0.0.15";
	qcom,fg-profile-data = [
		 D9 83 7B 7C 
		 DF 80 EB 76 
		 6D 83 73 76 
		 9F 8A 44 95 
		 FB 81 3B 9A 
		 A7 BC A5 C8 
		 52 13 E9 83 
		 A1 7C DF 80 
		 C8 76 61 83 
		 A6 64 20 88 
		 E0 8F 2F 82 
		 13 9A 29 BD 
		 FB C9 54 0E 
		 6C 0C 8B 59 
		 14 70 B2 FD 
		 68 3D A3 3D 
		 3F 29 00 00 
		 5F 44 C1 33 
		 5E 44 00 00 
		 00 00 00 00 
		 00 00 00 00 
		 27 70 57 6B 
		 4B 6B 16 88 
		 88 74 EA 63 
		 4B 65 3F 7A 
		 F5 6F F7 62 
		 14 69 96 A9 
		 17 3E 63 17 
		 65 A0 71 0C 
		 28 00 FF 36 
		 F0 11 30 03 
		 00 00 00 0C 
	];
};
