/*
 * Copyright (c) 2015, The Linux Foundation. All rights reserved.
 *
 * This program is free software; you can redistribute it and/or modify
 * it under the terms of the GNU General Public License version 2 and
 * only version 2 as published by the Free Software Foundation.
 *
 * This program is distributed in the hope that it will be useful,
 * but WITHOUT ANY WARRANTY; without even the implied warranty of
 * MERCHANTABILITY or FITNESS FOR A PARTICULAR PURPOSE.  See the
 * GNU General Public License for more details.
 */

/*---------------------------------------------------------------------------
 * This file is autogenerated file using gcdb parser. Please do not edit it.
 * Update input XML file to add a new entry or update variable in this file
 * VERSION = "1.0"
 *---------------------------------------------------------------------------*/
&mdss_mdp {
	dsi_nt35596h_1080p_vdo_p7701: qcom,mdss_dsi_nt35596h_1080p_vdo {
		qcom,mdss-dsi-panel-name = "nt35596h 1080p video mode dsi panel";
		qcom,mdss-dsi-panel-controller = <&mdss_dsi0>;
		qcom,mdss-dsi-panel-type = "dsi_video_mode";
		qcom,mdss-dsi-panel-destination = "display_1";
		qcom,mdss-dsi-panel-framerate = <60>;
		qcom,mdss-dsi-virtual-channel-id = <0>;
		qcom,mdss-dsi-stream = <0>;
		qcom,mdss-dsi-panel-width = <1080>;
		qcom,mdss-dsi-panel-height = <1920>;
		qcom,mdss-dsi-h-front-porch = <45>;
		qcom,mdss-dsi-h-back-porch = <45>;
		qcom,mdss-dsi-h-pulse-width = <8>;
		qcom,mdss-dsi-h-sync-skew = <0>;
		qcom,mdss-dsi-v-back-porch = <6>;
		qcom,mdss-dsi-v-front-porch = <16>;
		qcom,mdss-dsi-v-pulse-width = <6>;
		qcom,mdss-dsi-h-left-border = <0>;
		qcom,mdss-dsi-h-right-border = <0>;
		qcom,mdss-dsi-v-top-border = <0>;
		qcom,mdss-dsi-v-bottom-border = <0>;
		qcom,mdss-dsi-bpp = <24>;
		qcom,mdss-dsi-underflow-color = <0xff>;
		qcom,mdss-dsi-border-color = <0>;
		qcom,mdss-dsi-on-command = [15 01 00 00 00 00 02 FF 05
		15 01 00 00 00 00 02 FB 01
		15 01 00 00 00 00 02 C5 31
		15 01 00 00 00 00 02 FF EE
		15 01 00 00 00 00 02 FB 01
		15 01 00 00 14 00 02 18 40
		15 01 00 00 0A 00 02 18 00
		15 01 00 00 00 00 02 FF EE
		15 01 00 00 00 00 02 7C 31

		15 01 00 00 00 00 02 FB 01
		15 01 00 00 00 00 02 FF 01
		15 01 00 00 00 00 02 30 0F
		15 01 00 00 00 00 02 00 01
		15 01 00 00 00 00 02 01 55
		15 01 00 00 00 00 02 02 40
		15 01 00 00 00 00 02 05 50
		15 01 00 00 00 00 02 06 4A
		15 01 00 00 00 00 02 07 29
		15 01 00 00 00 00 02 08 0C
		15 01 00 00 00 00 02 0B 73   
		15 01 00 00 00 00 02 0C 73
		15 01 00 00 00 00 02 0E B0
		15 01 00 00 00 00 02 0F AE
		15 01 00 00 00 00 02 13 03
		
		15 01 00 00 00 00 02 14 4A
		15 01 00 00 00 00 02 15 12
		15 01 00 00 00 00 02 16 12
		15 01 00 00 00 00 02 18 00
		15 01 00 00 00 00 02 19 77
		15 01 00 00 00 00 02 1A 55
		15 01 00 00 00 00 02 1B 13
		15 01 00 00 00 00 02 1C 00
		15 01 00 00 00 00 02 1D 00
		15 01 00 00 00 00 02 1E 00
		15 01 00 00 00 00 02 1F 00
		15 01 00 00 00 00 02 58 82
		15 01 00 00 00 00 02 59 02
		15 01 00 00 00 00 02 5A 02
		15 01 00 00 00 00 02 5B 02
		15 01 00 00 00 00 02 5C 82
		15 01 00 00 00 00 02 5D 82
		15 01 00 00 00 00 02 5E 02
		15 01 00 00 00 00 02 5F 02
		15 01 00 00 00 00 02 72 31
		
		15 01 00 00 00 00 02 FB 01
		15 01 00 00 00 00 02 FF 05
		15 01 00 00 00 00 02 00 01
		15 01 00 00 00 00 02 01 0B
		15 01 00 00 00 00 02 02 0C
		15 01 00 00 00 00 02 03 09
		15 01 00 00 00 00 02 04 0A
		15 01 00 00 00 00 02 05 00
		15 01 00 00 00 00 02 06 0F
		15 01 00 00 00 00 02 07 10
		15 01 00 00 00 00 02 08 1A
		15 01 00 00 00 00 02 09 00
		15 01 00 00 00 00 02 0A 00
		15 01 00 00 00 00 02 0B 00
		15 01 00 00 00 00 02 0C 00
		15 01 00 00 00 00 02 0D 13
		15 01 00 00 00 00 02 0E 15
		15 01 00 00 00 00 02 0F 17
		15 01 00 00 00 00 02 10 01
		15 01 00 00 00 00 02 11 0B
		15 01 00 00 00 00 02 12 0C
		15 01 00 00 00 00 02 13 09
		15 01 00 00 00 00 02 14 0A
		15 01 00 00 00 00 02 15 00
		15 01 00 00 00 00 02 16 0F
		15 01 00 00 00 00 02 17 10
		15 01 00 00 00 00 02 18 1A
		15 01 00 00 00 00 02 19 00
		15 01 00 00 00 00 02 1A 00
		15 01 00 00 00 00 02 1B 00
		15 01 00 00 00 00 02 1C 00
		15 01 00 00 00 00 02 1D 13
		15 01 00 00 00 00 02 1E 15
		15 01 00 00 00 00 02 1F 17
		15 01 00 00 00 00 02 20 00
		15 01 00 00 00 00 02 21 01
		15 01 00 00 00 00 02 22 00
		15 01 00 00 00 00 02 23 40
		15 01 00 00 00 00 02 24 40
		15 01 00 00 00 00 02 25 6D
		15 01 00 00 00 00 02 29 D8
		15 01 00 00 00 00 02 2A 2A
		15 01 00 00 00 00 02 2B 00
		15 01 00 00 00 00 02 B6 89
		15 01 00 00 00 00 02 B7 14
		15 01 00 00 00 00 02 B8 05
		15 01 00 00 00 00 02 4B 04
		15 01 00 00 00 00 02 4C 11
		15 01 00 00 00 00 02 4D 10
		15 01 00 00 00 00 02 4E 01
		15 01 00 00 00 00 02 4F 01
		15 01 00 00 00 00 02 50 10
		15 01 00 00 00 00 02 51 00
		15 01 00 00 00 00 02 52 00
		15 01 00 00 00 00 02 53 08
		15 01 00 00 00 00 02 54 01
		15 01 00 00 00 00 02 55 6D
		15 01 00 00 00 00 02 5B 44
		15 01 00 00 00 00 02 5C 00
		15 01 00 00 00 00 02 5F 74
		15 01 00 00 00 00 02 60 75
		15 01 00 00 00 00 02 63 FF
		15 01 00 00 00 00 02 64 00
		15 01 00 00 00 00 02 67 04
		15 01 00 00 00 00 02 68 04
		15 01 00 00 00 00 02 6C 00
		15 01 00 00 00 00 02 7A 80
		15 01 00 00 00 00 02 7B 91
		15 01 00 00 00 00 02 7C D8
		15 01 00 00 00 00 02 7D 60
		15 01 00 00 00 00 02 7F 15
		15 01 00 00 00 00 02 80 00
		15 01 00 00 00 00 02 83 00
		15 01 00 00 00 00 02 93 08
		15 01 00 00 00 00 02 94 0A
		15 01 00 00 00 00 02 8A 00
		15 01 00 00 00 00 02 9B 0F
		15 01 00 00 00 00 02 FF 01
		15 01 00 00 00 00 02 FB 01
		15 01 00 00 00 00 02 75 00
		15 01 00 00 00 00 02 76 03
		15 01 00 00 00 00 02 77 00
		15 01 00 00 00 00 02 78 1D
		15 01 00 00 00 00 02 79 00
		15 01 00 00 00 00 02 7A 41
		15 01 00 00 00 00 02 7B 00
		15 01 00 00 00 00 02 7C 5E
		15 01 00 00 00 00 02 7D 00
		15 01 00 00 00 00 02 7E 76
		15 01 00 00 00 00 02 7F 00
		15 01 00 00 00 00 02 80 8A
		15 01 00 00 00 00 02 81 00
		15 01 00 00 00 00 02 82 9E
		15 01 00 00 00 00 02 83 00
		15 01 00 00 00 00 02 84 AF
		15 01 00 00 00 00 02 85 00
		15 01 00 00 00 00 02 86 BE
		15 01 00 00 00 00 02 87 00
		15 01 00 00 00 00 02 88 f1
		15 01 00 00 00 00 02 89 01
		15 01 00 00 00 00 02 8A 1A
		15 01 00 00 00 00 02 8B 01
		15 01 00 00 00 00 02 8C 57
		15 01 00 00 00 00 02 8D 01
		15 01 00 00 00 00 02 8E 8c
		15 01 00 00 00 00 02 8F 01
		15 01 00 00 00 00 02 90 d9
		15 01 00 00 00 00 02 91 02
		15 01 00 00 00 00 02 92 14
		15 01 00 00 00 00 02 93 02
		15 01 00 00 00 00 02 94 17
		15 01 00 00 00 00 02 95 02
		15 01 00 00 00 00 02 96 47
		15 01 00 00 00 00 02 97 02
		15 01 00 00 00 00 02 98 80
		15 01 00 00 00 00 02 99 02
		15 01 00 00 00 00 02 9A aa
		15 01 00 00 00 00 02 9B 02
		15 01 00 00 00 00 02 9C da
		15 01 00 00 00 00 02 9D 02
		15 01 00 00 00 00 02 9E fa
		15 01 00 00 00 00 02 9F 03
		15 01 00 00 00 00 02 A0 2a
		15 01 00 00 00 00 02 A2 03
		15 01 00 00 00 00 02 A3 34
		15 01 00 00 00 00 02 A4 03
		15 01 00 00 00 00 02 A5 44
		15 01 00 00 00 00 02 A6 03
		15 01 00 00 00 00 02 A7 56
		15 01 00 00 00 00 02 A9 03
		15 01 00 00 00 00 02 AA 66
		15 01 00 00 00 00 02 AB 03
		15 01 00 00 00 00 02 AC 78
		15 01 00 00 00 00 02 AD 03
		15 01 00 00 00 00 02 AE A5
		15 01 00 00 00 00 02 AF 03
		15 01 00 00 00 00 02 B0 E8
		15 01 00 00 00 00 02 B1 03
		15 01 00 00 00 00 02 B2 F8
		15 01 00 00 00 00 02 B3 00
		15 01 00 00 00 00 02 B4 03
		15 01 00 00 00 00 02 B5 00
		15 01 00 00 00 00 02 B6 1D
		15 01 00 00 00 00 02 B7 00
		15 01 00 00 00 00 02 B8 41
		15 01 00 00 00 00 02 B9 00
		15 01 00 00 00 00 02 BA 5E
		15 01 00 00 00 00 02 BB 00
		15 01 00 00 00 00 02 BC 76
		15 01 00 00 00 00 02 BD 00
		15 01 00 00 00 00 02 BE 8A
		15 01 00 00 00 00 02 BF 00
		15 01 00 00 00 00 02 C0 9E
		15 01 00 00 00 00 02 C1 00
		15 01 00 00 00 00 02 C2 AF
		15 01 00 00 00 00 02 C3 00
		15 01 00 00 00 00 02 C4 BE
		15 01 00 00 00 00 02 C5 00
		15 01 00 00 00 00 02 C6 f1
		15 01 00 00 00 00 02 C7 01
		15 01 00 00 00 00 02 C8 1A
		15 01 00 00 00 00 02 C9 01
		15 01 00 00 00 00 02 CA 57
		15 01 00 00 00 00 02 CB 01
		15 01 00 00 00 00 02 CC 8c
		15 01 00 00 00 00 02 CD 01
		15 01 00 00 00 00 02 CE d9
		15 01 00 00 00 00 02 CF 02
		15 01 00 00 00 00 02 D0 14
		15 01 00 00 00 00 02 D1 02
		15 01 00 00 00 00 02 D2 17
		15 01 00 00 00 00 02 D3 02
		15 01 00 00 00 00 02 D4 47
		15 01 00 00 00 00 02 D5 02
		15 01 00 00 00 00 02 D6 80
		15 01 00 00 00 00 02 D7 02
		15 01 00 00 00 00 02 D8 aa
		15 01 00 00 00 00 02 D9 02
		15 01 00 00 00 00 02 DA da
		15 01 00 00 00 00 02 DB 02
		15 01 00 00 00 00 02 DC fa
		15 01 00 00 00 00 02 DD 03
		15 01 00 00 00 00 02 DE 2a
		15 01 00 00 00 00 02 DF 03
		15 01 00 00 00 00 02 E0 34
		15 01 00 00 00 00 02 E1 03
		15 01 00 00 00 00 02 E2 44
		15 01 00 00 00 00 02 E3 03
		15 01 00 00 00 00 02 E4 56
		15 01 00 00 00 00 02 E5 03
		15 01 00 00 00 00 02 E6 66
		15 01 00 00 00 00 02 E7 03
		15 01 00 00 00 00 02 E8 78
		15 01 00 00 00 00 02 E9 03
		15 01 00 00 00 00 02 EA A5
		15 01 00 00 00 00 02 EB 03
		15 01 00 00 00 00 02 EC E8
		15 01 00 00 00 00 02 ED 03
		15 01 00 00 00 00 02 EE F8
		15 01 00 00 00 00 02 EF 00
		15 01 00 00 00 00 02 F0 03
		15 01 00 00 00 00 02 F1 00
		15 01 00 00 00 00 02 F2 1D
		15 01 00 00 00 00 02 F3 00
		15 01 00 00 00 00 02 F4 41
		15 01 00 00 00 00 02 F5 00
		15 01 00 00 00 00 02 F6 5E
		15 01 00 00 00 00 02 F7 00
		15 01 00 00 00 00 02 F8 76
		15 01 00 00 00 00 02 F9 00
		15 01 00 00 00 00 02 FA 8A
		15 01 00 00 00 00 02 FF 02
		15 01 00 00 00 00 02 FB 01
		15 01 00 00 00 00 02 00 00
		15 01 00 00 00 00 02 01 9E
		15 01 00 00 00 00 02 02 00
		15 01 00 00 00 00 02 03 AF
		15 01 00 00 00 00 02 04 00
		15 01 00 00 00 00 02 05 BE
		15 01 00 00 00 00 02 06 00
		15 01 00 00 00 00 02 07 f1
		15 01 00 00 00 00 02 08 01
		15 01 00 00 00 00 02 09 1A
		15 01 00 00 00 00 02 0A 01
		15 01 00 00 00 00 02 0B 57
		15 01 00 00 00 00 02 0C 01
		15 01 00 00 00 00 02 0D 8c
		15 01 00 00 00 00 02 0E 01
		15 01 00 00 00 00 02 0F d9
		15 01 00 00 00 00 02 10 02
		15 01 00 00 00 00 02 11 14
		15 01 00 00 00 00 02 12 02
		15 01 00 00 00 00 02 13 17
		15 01 00 00 00 00 02 14 02
		15 01 00 00 00 00 02 15 47
		15 01 00 00 00 00 02 16 02
		15 01 00 00 00 00 02 17 80
		15 01 00 00 00 00 02 18 02
		15 01 00 00 00 00 02 19 aa
		15 01 00 00 00 00 02 1A 02
		15 01 00 00 00 00 02 1B da
		15 01 00 00 00 00 02 1C 02
		15 01 00 00 00 00 02 1D fa
		15 01 00 00 00 00 02 1E 03
		15 01 00 00 00 00 02 1F 2a
		15 01 00 00 00 00 02 20 03
		15 01 00 00 00 00 02 21 34
		15 01 00 00 00 00 02 22 03
		15 01 00 00 00 00 02 23 44
		15 01 00 00 00 00 02 24 03
		15 01 00 00 00 00 02 25 56
		15 01 00 00 00 00 02 26 03
		15 01 00 00 00 00 02 27 66
		15 01 00 00 00 00 02 28 03
		15 01 00 00 00 00 02 29 78
		15 01 00 00 00 00 02 2A 03
		15 01 00 00 00 00 02 2B A5
		15 01 00 00 00 00 02 2D 03
		15 01 00 00 00 00 02 2F E8
		15 01 00 00 00 00 02 30 03
		15 01 00 00 00 00 02 31 F8
		15 01 00 00 00 00 02 32 00
		15 01 00 00 00 00 02 33 03
		15 01 00 00 00 00 02 34 00
		15 01 00 00 00 00 02 35 1D
		15 01 00 00 00 00 02 36 00
		15 01 00 00 00 00 02 37 41
		15 01 00 00 00 00 02 38 00
		15 01 00 00 00 00 02 39 5E
		15 01 00 00 00 00 02 3A 00
		15 01 00 00 00 00 02 3B 76
		15 01 00 00 00 00 02 3D 00
		15 01 00 00 00 00 02 3F 8A
		15 01 00 00 00 00 02 40 00
		15 01 00 00 00 00 02 41 9E
		15 01 00 00 00 00 02 42 00
		15 01 00 00 00 00 02 43 AF
		15 01 00 00 00 00 02 44 00
		15 01 00 00 00 00 02 45 BE
		15 01 00 00 00 00 02 46 00
		15 01 00 00 00 00 02 47 f1
		15 01 00 00 00 00 02 48 01
		15 01 00 00 00 00 02 49 1A
		15 01 00 00 00 00 02 4A 01
		15 01 00 00 00 00 02 4B 57
		15 01 00 00 00 00 02 4C 01
		15 01 00 00 00 00 02 4D 8c
		15 01 00 00 00 00 02 4E 01
		15 01 00 00 00 00 02 4F d9
		15 01 00 00 00 00 02 50 02
		15 01 00 00 00 00 02 51 14
		15 01 00 00 00 00 02 52 02
		15 01 00 00 00 00 02 53 17
		15 01 00 00 00 00 02 54 02
		15 01 00 00 00 00 02 55 47
		15 01 00 00 00 00 02 56 02
		15 01 00 00 00 00 02 58 80
		15 01 00 00 00 00 02 59 02
		15 01 00 00 00 00 02 5A aa
		15 01 00 00 00 00 02 5B 02
		15 01 00 00 00 00 02 5C da
		15 01 00 00 00 00 02 5D 02
		15 01 00 00 00 00 02 5E fa
		15 01 00 00 00 00 02 5F 03
		15 01 00 00 00 00 02 60 2a
		15 01 00 00 00 00 02 61 03
		15 01 00 00 00 00 02 62 34
		15 01 00 00 00 00 02 63 03
		15 01 00 00 00 00 02 64 44
		15 01 00 00 00 00 02 65 03
		15 01 00 00 00 00 02 66 56
		15 01 00 00 00 00 02 67 03
		15 01 00 00 00 00 02 68 66
		15 01 00 00 00 00 02 69 03
		15 01 00 00 00 00 02 6A 78
		15 01 00 00 00 00 02 6B 03
		15 01 00 00 00 00 02 6C A5
		15 01 00 00 00 00 02 6D 03
		15 01 00 00 00 00 02 6E E8
		15 01 00 00 00 00 02 6F 03
		15 01 00 00 00 00 02 70 F8
		15 01 00 00 00 00 02 71 00
		15 01 00 00 00 00 02 72 03
		15 01 00 00 00 00 02 73 00
		15 01 00 00 00 00 02 74 1D
		15 01 00 00 00 00 02 75 00
		15 01 00 00 00 00 02 76 41
		15 01 00 00 00 00 02 77 00
		15 01 00 00 00 00 02 78 5E
		15 01 00 00 00 00 02 79 00
		15 01 00 00 00 00 02 7A 76
		15 01 00 00 00 00 02 7B 00
		15 01 00 00 00 00 02 7C 8A
		15 01 00 00 00 00 02 7D 00
		15 01 00 00 00 00 02 7E 9E
		15 01 00 00 00 00 02 7F 00
		15 01 00 00 00 00 02 80 AF
		15 01 00 00 00 00 02 81 00
		15 01 00 00 00 00 02 82 BE
		15 01 00 00 00 00 02 83 00
		15 01 00 00 00 00 02 84 f1
		15 01 00 00 00 00 02 85 01
		15 01 00 00 00 00 02 86 1A
		15 01 00 00 00 00 02 87 01
		15 01 00 00 00 00 02 88 57
		15 01 00 00 00 00 02 89 01
		15 01 00 00 00 00 02 8A 8c
		15 01 00 00 00 00 02 8B 01
		15 01 00 00 00 00 02 8C d9
		15 01 00 00 00 00 02 8D 02
		15 01 00 00 00 00 02 8E 14
		15 01 00 00 00 00 02 8F 02
		15 01 00 00 00 00 02 90 17
		15 01 00 00 00 00 02 91 02
		15 01 00 00 00 00 02 92 47
		15 01 00 00 00 00 02 93 02
		15 01 00 00 00 00 02 94 80
		15 01 00 00 00 00 02 95 02
		15 01 00 00 00 00 02 96 aa
		15 01 00 00 00 00 02 97 02
		15 01 00 00 00 00 02 98 da
		15 01 00 00 00 00 02 99 02
		15 01 00 00 00 00 02 9A fa
		15 01 00 00 00 00 02 9B 03
		15 01 00 00 00 00 02 9C 2a
		15 01 00 00 00 00 02 9D 03
		15 01 00 00 00 00 02 9E 34
		15 01 00 00 00 00 02 9F 03
		15 01 00 00 00 00 02 A0 44
		15 01 00 00 00 00 02 A2 03
		15 01 00 00 00 00 02 A3 56
		15 01 00 00 00 00 02 A4 03
		15 01 00 00 00 00 02 A5 66
		15 01 00 00 00 00 02 A6 03
		15 01 00 00 00 00 02 A7 78
		15 01 00 00 00 00 02 A9 03
		15 01 00 00 00 00 02 AA A5
		15 01 00 00 00 00 02 AB 03
		15 01 00 00 00 00 02 AC E8
		15 01 00 00 00 00 02 AD 03
		15 01 00 00 00 00 02 AE F8
		15 01 00 00 00 00 02 AF 00
		15 01 00 00 00 00 02 B0 03
		15 01 00 00 00 00 02 B1 00
		15 01 00 00 00 00 02 B2 1D
		15 01 00 00 00 00 02 B3 00
		15 01 00 00 00 00 02 B4 41
		15 01 00 00 00 00 02 B5 00
		15 01 00 00 00 00 02 B6 5E
		15 01 00 00 00 00 02 B7 00
		15 01 00 00 00 00 02 B8 76
		15 01 00 00 00 00 02 B9 00
		15 01 00 00 00 00 02 BA 8A
		15 01 00 00 00 00 02 BB 00
		15 01 00 00 00 00 02 BC 9E
		15 01 00 00 00 00 02 BD 00
		15 01 00 00 00 00 02 BE AF
		15 01 00 00 00 00 02 BF 00
		15 01 00 00 00 00 02 C0 BE
		15 01 00 00 00 00 02 C1 00
		15 01 00 00 00 00 02 C2 f1
		15 01 00 00 00 00 02 C3 01
		15 01 00 00 00 00 02 C4 1A
		15 01 00 00 00 00 02 C5 01
		15 01 00 00 00 00 02 C6 57
		15 01 00 00 00 00 02 C7 01
		15 01 00 00 00 00 02 C8 8c
		15 01 00 00 00 00 02 C9 01
		15 01 00 00 00 00 02 CA d9
		15 01 00 00 00 00 02 CB 02
		15 01 00 00 00 00 02 CC 14
		15 01 00 00 00 00 02 CD 02
		15 01 00 00 00 00 02 CE 17
		15 01 00 00 00 00 02 CF 02
		15 01 00 00 00 00 02 D0 47
		15 01 00 00 00 00 02 D1 02
		15 01 00 00 00 00 02 D2 80
		15 01 00 00 00 00 02 D3 02
		15 01 00 00 00 00 02 D4 aa
		15 01 00 00 00 00 02 D5 02
		15 01 00 00 00 00 02 D6 da
		15 01 00 00 00 00 02 D7 02
		15 01 00 00 00 00 02 D8 fa
		15 01 00 00 00 00 02 D9 03
		15 01 00 00 00 00 02 DA 2a
		15 01 00 00 00 00 02 DB 03
		15 01 00 00 00 00 02 DC 34
		15 01 00 00 00 00 02 DD 03
		15 01 00 00 00 00 02 DE 44
		15 01 00 00 00 00 02 DF 03
		15 01 00 00 00 00 02 E0 56
		15 01 00 00 00 00 02 E1 03
		15 01 00 00 00 00 02 E2 66
		15 01 00 00 00 00 02 E3 03
		15 01 00 00 00 00 02 E4 78
		15 01 00 00 00 00 02 E5 03
		15 01 00 00 00 00 02 E6 A5
		15 01 00 00 00 00 02 E7 03
		15 01 00 00 00 00 02 E8 E8
		15 01 00 00 00 00 02 E9 03
		15 01 00 00 00 00 02 EA F8

		15 01 00 00 00 00 02 FF 05
		15 01 00 00 00 00 02 FB 01
		15 01 00 00 00 00 02 E7 80
		15 01 00 00 00 00 02 FB 01
		15 01 00 00 00 00 02 EC 00

		15 01 00 00 00 00 02 FF 00
		15 01 00 00 00 00 02 D3 0c
		15 01 00 00 00 00 02 D4 06
		15 01 00 00 00 00 02 FF 00
		15 01 00 00 00 00 02 35 00
    15 01 00 00 00 00 02 36 c0

		05 01 00 00 C8 00 02 11 00
		05 01 00 00 32 00 02 29 00];

		qcom,mdss-dsi-off-command = [05 01 00 00 00 00 02 28 00
					05 01 00 00 78 00 02 10 00];
		qcom,mdss-dsi-on-command-state = "dsi_lp_mode";
		qcom,mdss-dsi-off-command-state = "dsi_hs_mode";
            //Begin xiongdajun add ESD check for nt35596h
             qcom,esd-check-enabled;
             qcom,mdss-dsi-panel-status-command = [06 01 00 01 05 00 02 0A 08];
		qcom,mdss-dsi-panel-status-command-state = "dsi_lp_mode";
		qcom,mdss-dsi-panel-status-check-mode = "reg_read";
             qcom,mdss-dsi-panel-status-read-length = <1>;
		qcom,mdss-dsi-panel-status-value = <0x9c>;
              //END xiongdajun add ESD check for nt35596h
		qcom,mdss-dsi-h-sync-pulse = <1>;
		qcom,mdss-dsi-traffic-mode = "burst_mode";
		qcom,mdss-dsi-lane-map = "lane_map_0123";
		qcom,mdss-dsi-bllp-eof-power-mode;
		qcom,mdss-dsi-bllp-power-mode;
		qcom,mdss-dsi-lp11-init;
		qcom,mdss-dsi-init-delay-us = <5>;
		qcom,mdss-dsi-lane-0-state;
		qcom,mdss-dsi-lane-1-state;
		qcom,mdss-dsi-lane-2-state;
		qcom,mdss-dsi-lane-3-state;
		qcom,mdss-dsi-te-pin-select = <1>;
		qcom,mdss-dsi-wr-mem-start = <0x2c>;
		qcom,mdss-dsi-te-dcs-command = <1>;
		qcom,mdss-dsi-te-check-enable;
		qcom,mdss-dsi-te-using-te-pin;
		qcom,mdss-dsi-panel-timings = [6E 3F 36 00 5A 4F 38 41 54 03 04 00];
		qcom,mdss-dsi-t-clk-post = <0x1E>;
		qcom,mdss-dsi-t-clk-pre = <0x30>;
		qcom,mdss-dsi-bl-pmic-pwm-frequency = <100>;
		qcom,mdss-dsi-bl-pmic-bank-select = <0>;
		qcom,mdss-dsi-dma-trigger = "trigger_sw";
		qcom,mdss-dsi-mdp-trigger = "none";
		qcom,mdss-dsi-bl-pmic-control-type = "bl_ctrl_wled";
		qcom,mdss-dsi-bl-min-level = <1>;
		qcom,mdss-dsi-bl-max-level = <4095>;
		qcom,mdss-dsi-reset-sequence = <1 20>, <0 5>, <1 20>;
	};
};
