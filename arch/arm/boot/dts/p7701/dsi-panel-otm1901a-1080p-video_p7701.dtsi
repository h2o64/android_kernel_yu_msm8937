/*
 * Copyright (c) 2015, The Linux Foundation. All rights reserved.
 *
 * This program is free software; you can redistribute it and/or modify
 * it under the terms of the GNU General Public License version 2 and
 * only version 2 as published by the Free Software Foundation.
 *
 * This program is distributed in the hope that it will be useful,
 * but WITHOUT ANY WARRANTY; without even the implied warranty of
 * MERCHANTABILITY or FITNESS FOR A PARTICULAR PURPOSE.  See the
 * GNU General Public License for more details.
 */

/*---------------------------------------------------------------------------
 * This file is autogenerated file using gcdb parser. Please do not edit it.
 * Update input XML file to add a new entry or update variable in this file
 * VERSION = "1.0"
 *---------------------------------------------------------------------------*/
&mdss_mdp {
	dsi_otm1901a_1080p_vdo_p7701: qcom,mdss_dsi_otm1901a_1080p_vdo {
		qcom,mdss-dsi-panel-name = "otm1901a 1080p video mode dsi panel";
		qcom,mdss-dsi-panel-controller = <&mdss_dsi0>;
		qcom,mdss-dsi-panel-type = "dsi_video_mode";
		qcom,mdss-dsi-panel-destination = "display_1";
		qcom,mdss-dsi-panel-framerate = <60>;
		qcom,mdss-dsi-virtual-channel-id = <0>;
		qcom,mdss-dsi-stream = <0>;
		qcom,mdss-dsi-panel-width = <1080>;
		qcom,mdss-dsi-panel-height = <1920>;
		qcom,mdss-dsi-h-front-porch = <52>;
		qcom,mdss-dsi-h-back-porch = <52>;
		qcom,mdss-dsi-h-pulse-width = <8>;
		qcom,mdss-dsi-h-sync-skew = <0>;
		qcom,mdss-dsi-v-back-porch = <9>;
		qcom,mdss-dsi-v-front-porch = <14>;
		qcom,mdss-dsi-v-pulse-width = <1>;
		qcom,mdss-dsi-h-left-border = <0>;
		qcom,mdss-dsi-h-right-border = <0>;
		qcom,mdss-dsi-v-top-border = <0>;
		qcom,mdss-dsi-v-bottom-border = <0>;
		qcom,mdss-dsi-bpp = <24>;
		qcom,mdss-dsi-underflow-color = <0xff>;
		qcom,mdss-dsi-border-color = <0>;
		qcom,mdss-dsi-on-command = [15 01 00 00 00 00 02 00 00
		39 01 00 00 00 00 04 FF 19 01 01
		15 01 00 00 00 00 02 00 80
		39 01 00 00 00 00 03 FF 19 01
		15 01 00 00 00 00 02 00 00
		15 01 00 00 00 00 02 1c 33
		15 01 00 00 00 00 02 00 a0
		15 01 00 00 00 00 02 c1 e8
		15 01 00 00 00 00 02 00 a7
		15 01 00 00 00 00 02 c1 00
		15 01 00 00 00 00 02 00 90
		39 01 00 00 00 00 07 c0 00 2F 00 00 00 01
		15 01 00 00 00 00 02 00 C0
		39 01 00 00 00 00 07 c0 00 2F 00 00 00 01
		15 01 00 00 00 00 02 00 9a
		15 01 00 00 00 00 02 c0 1e
		15 01 00 00 00 00 02 00 ac
		15 01 00 00 00 00 02 c0 06
		15 01 00 00 00 00 02 00 dc
		15 01 00 00 00 00 02 c0 06
		15 01 00 00 00 00 02 00 81
		15 01 00 00 00 00 02 a5 04
		15 01 00 00 00 00 02 00 84
		15 01 00 00 00 00 02 c4 20
		15 01 00 00 00 00 02 00 a5
		15 01 00 00 00 00 02 b3 1d
		15 01 00 00 00 00 02 00 92
		15 01 00 00 00 00 02 e9 00
		15 01 00 00 00 00 02 00 90
		15 01 00 00 00 00 02 F3 01
		15 01 00 00 00 00 02 00 f7
		39 01 00 00 00 00 05 C3 04 18 04 04
		15 01 00 00 00 00 02 00 B4
		15 01 00 00 00 00 02 C0 d0
		15 01 00 00 00 00 02 00 93
		15 01 00 00 00 00 02 C5 19
		15 01 00 00 00 00 02 00 95
		15 01 00 00 00 00 02 C5 2D
		15 01 00 00 00 00 02 00 97
		15 01 00 00 00 00 02 C5 14
		15 01 00 00 00 00 02 00 99
		15 01 00 00 00 00 02 C5 29
		15 01 00 00 00 00 02 00 00
		39 01 00 00 00 00 03 D8 23 23
		15 01 00 00 00 00 02 00 00
		39 01 00 00 00 00 19 E1 00 08 0E 1A 23 2B 38 49 54 66 70 76 86 81 7C 6D 58 45 37 2F 25 19 17 03
		15 01 00 00 00 00 02 00 00
		39 01 00 00 00 00 19 E2 00 08 0E 1A 23 2B 38 49 54 66 70 76 86 81 7C 6D 58 45 37 2F 25 19 17 03
		15 01 00 00 00 00 02 00 00
		39 01 00 00 00 00 19 E3 00 08 0E 1A 23 2B 38 49 54 66 70 76 86 81 7C 6D 58 45 37 2F 25 19 17 03
		15 01 00 00 00 00 02 00 00
		39 01 00 00 00 00 19 E4 00 08 0E 1A 23 2B 38 49 54 66 70 76 86 81 7C 6D 58 45 37 2F 25 19 17 03
		15 01 00 00 00 00 02 00 00
		39 01 00 00 00 00 19 E5 00 08 0E 1A 23 2B 38 49 54 66 70 76 86 81 7C 6D 58 45 37 2F 25 19 17 03
		15 01 00 00 00 00 02 00 00
		39 01 00 00 00 00 19 E6 00 08 0E 1A 23 2B 38 49 54 66 70 76 86 81 7C 6D 58 45 37 2F 25 19 17 03
		15 01 00 00 00 00 02 00 81
		15 01 00 00 00 00 02 A5 07
		15 01 00 00 00 00 02 00 9D
		15 01 00 00 00 00 02 C5 77
		15 01 00 00 00 00 02 00 B3
		15 01 00 00 00 00 02 C0 CC
		15 01 00 00 00 00 02 00 BC
		15 01 00 00 00 00 02 C0 00
		15 01 00 00 00 00 02 00 80
		39 01 00 00 00 00 0F C0 00 83 00 0A 0A 00 83 0A 0A 00 83 00 0A 0A
		15 01 00 00 00 00 02 00 F0
		39 01 00 00 00 00 07 C3 22 02 00 00 00 0C
		15 01 00 00 00 00 02 00 A0
		39 01 00 00 00 00 08 C0 00 00 00 00 03 22 03
		15 01 00 00 00 00 02 00 D0
		39 01 00 00 00 00 08 C0 00 00 00 00 03 22 03
		15 01 00 00 00 00 02 00 90
		39 01 00 00 00 00 09 C2 83 01 00 00 82 01 00 00
		15 01 00 00 00 00 02 00 80
		39 01 00 00 00 00 0D C3 82 18 03 00 03 84 81 18 03 00 03 84
		15 01 00 00 00 00 02 00 90
		39 01 00 00 00 00 0D C3 00 18 03 00 03 84 01 18 03 00 03 84
		15 01 00 00 00 00 02 00 80
		39 01 00 00 00 00 10 CC 09 0A 11 12 13 14 15 16 17 18 28 28 28 28 28
		15 01 00 00 00 00 02 00 90
		39 01 00 00 00 00 10 CC 0A 09 14 13 12 11 15 16 17 18 28 28 28 28 28
		15 01 00 00 00 00 02 00 A0
		39 01 00 00 00 00 10 CC 1D 1E 1F 19 1A 1B 1C 20 21 22 23 24 25 26 27
		15 01 00 00 00 00 02 00 B0
		39 01 00 00 00 00 09 CC 01 02 03 05 06 07 04 08
		15 01 00 00 00 00 02 00 C0
		39 01 00 00 00 00 0D CC 00 00 00 00 00 00 00 00 00 00 00 77
		15 01 00 00 00 00 02 00 D0
		39 01 00 00 00 00 0D CC FF 0F 00 00 0F C0 03 00 33 03 00 77
		15 01 00 00 00 00 02 00 80
		39 01 00 00 00 00 10 CB 00 00 00 00 00 00 00 00 00 00 00 00 00 00 00
		15 01 00 00 00 00 02 00 90
		39 01 00 00 00 00 10 CB 00 00 00 00 00 00 00 00 00 00 00 00 00 00 00
		15 01 00 00 00 00 02 00 A0
		39 01 00 00 00 00 10 CB 01 01 01 01 01 01 00 00 00 00 00 00 00 00 00
		15 01 00 00 00 00 02 00 B0
		39 01 00 00 00 00 10 CB 00 01 FD 00 00 00 00 00 FF 00 00 00 00 00 00
		15 01 00 00 00 00 02 00 C0
		39 01 00 00 00 00 09 CB 00 00 00 00 00 00 77 77
		15 01 00 00 00 00 02 00 D0
		39 01 00 00 00 00 09 CB 00 00 00 00 00 00 77 77
		15 01 00 00 00 00 02 00 E0
		39 01 00 00 00 00 09 CB 00 00 00 00 00 00 77 77
		15 01 00 00 00 00 02 00 F0
		39 01 00 00 00 00 09 CB 01 01 01 00 00 00 77 77
		15 01 00 00 00 00 02 00 80
		39 01 00 00 00 00 10 CD 3F 3F 3F 3F 3F 3F 3F 17 3F 02 12 11 3F 04 3F
		15 01 00 00 00 00 02 00 90
		39 01 00 00 00 00 0C CD 06 18 3F 26 26 26 21 20 1F 26 26
		15 01 00 00 00 00 02 00 A0
		39 01 00 00 00 00 10 CD 3F 3F 3F 3F 3F 3F 17 3F 3F 01 12 11 3F 03 3F
		15 01 00 00 00 00 02 00 B0
		39 01 00 00 00 00 0C CD 05 18 3F 26 26 26 21 20 1F 26 26
		15 01 00 00 00 00 02 00 9B
		39 01 00 00 00 00 03 C5 55 55
		15 01 00 00 00 00 02 00 80
		15 01 00 00 00 00 02 C4 15
		15 01 00 00 00 00 02 00 C1
		15 01 00 00 00 00 02 C5 BB
		15 01 00 00 00 00 02 00 A2
             15 01 00 00 00 00 02 C1 30
             	15 01 00 00 00 00 02 00 90
             15 01 00 00 00 00 02 b0 00
             15 01 00 00 00 00 02 00 C2
             15 01 00 00 00 00 02 b0 14
		15 01 00 00 00 00 02 00 00
		39 01 00 00 00 00 04 FF FF FF FF
		15 01 00 00 00 00 02 35 00
		15 01 00 00 78 00 02 11 00 
		15 01 00 00 32 00 02 29 00
		15 01 00 00 00 00 02 00 00
		39 01 00 00 00 00 03 99 00 00];

		qcom,mdss-dsi-off-command = [15 01 00 00 00 00 02 00 00
					39 01 00 00 00 00 03 99 95 27
					05 01 00 00 00 00 02 28 00
					05 01 00 00 78 00 02 10 00];
		qcom,mdss-dsi-on-command-state = "dsi_lp_mode";
		qcom,mdss-dsi-off-command-state = "dsi_hs_mode";
		//add ESD check
             qcom,esd-check-enabled;
             qcom,mdss-dsi-panel-status-command = [06 01 00 01 05 00 02 0A 08];
		qcom,mdss-dsi-panel-status-command-state = "dsi_hs_mode";
		qcom,mdss-dsi-panel-status-check-mode = "reg_read";
             qcom,mdss-dsi-panel-status-read-length = <1>;
		qcom,mdss-dsi-panel-status-value = <0x9c>;
              //END add ESD check
		qcom,mdss-dsi-h-sync-pulse = <1>;
		qcom,mdss-dsi-traffic-mode = "burst_mode";
		qcom,mdss-dsi-lane-map = "lane_map_0123";
		qcom,mdss-dsi-bllp-eof-power-mode;
		qcom,mdss-dsi-bllp-power-mode;
		qcom,mdss-dsi-lp11-init;
		qcom,mdss-dsi-init-delay-us = <5>;
		qcom,mdss-dsi-lane-0-state;
		qcom,mdss-dsi-lane-1-state;
		qcom,mdss-dsi-lane-2-state;
		qcom,mdss-dsi-lane-3-state;
		qcom,mdss-dsi-te-pin-select = <1>;
		qcom,mdss-dsi-wr-mem-start = <0x2c>;
		qcom,mdss-dsi-te-dcs-command = <1>;
		qcom,mdss-dsi-te-check-enable;
		qcom,mdss-dsi-te-using-te-pin;
		qcom,mdss-dsi-panel-timings = [E3 34 22 00 64 66 28 38 2B 03 04 00];
		qcom,mdss-dsi-t-clk-post = <0x1E>;
		qcom,mdss-dsi-t-clk-pre = <0x30>;
		qcom,mdss-dsi-bl-pmic-pwm-frequency = <100>;
		qcom,mdss-dsi-bl-pmic-bank-select = <0>;
		qcom,mdss-dsi-dma-trigger = "trigger_sw";
		qcom,mdss-dsi-mdp-trigger = "none";
		qcom,mdss-dsi-bl-pmic-control-type = "bl_ctrl_wled";
		qcom,mdss-dsi-bl-min-level = <1>;
		qcom,mdss-dsi-bl-max-level = <4095>;
		qcom,mdss-dsi-reset-sequence = <1 20>, <0 20>, <1 120>;
	};
};
